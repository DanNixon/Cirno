/**
 * Sample with bitmap images.
 *
 * Original image from here: http://kane-neko.deviantart.com/art/Touhou-Chibi-Cirno-290965347
 * Image array generated with: https://github.com/DanNixon/GLCD-BitmapConverter
 */

#include "U8glib.h"
#include "UniversalButtons.h"

#include "TiLDA_MKe.h"

TiLDA_MKe tilda;

const uint8_t cirno_bitmap[] U8G_PROGMEM =
{
  0x00,0x00,0x00,0x00,0x00,0x00,0x00,
  0x00,0x01,0xf8,0x00,0x00,0x07,0xe0,
  0x00,0x07,0xff,0x00,0x00,0x3f,0xf8,
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  0x00,0x00,0x00,0x00,0x00,0x80,0x00,
};

const uint8_t big_cirno_bitmap[] U8G_PROGMEM =
{
  0x00,0x00,0x00,0x00,0x00,0x00,0x00,
  0x00,0x00,0x00,0x00,0x00,0x00,0x00,
  0x00,0x01,0xf8,0x00,0x00,0x07,0xe0,
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  0x00,0x00,0x00,0x00,0x00,0x00,0x00,
};

bool landscape = false;

void setup(void)
{
  SerialUSB.begin(115200);
  SerialUSB.println("Cirno");

  tilda.setBacklight(LCD_BACKLIGHT_ON);

  // Set button callback
  tilda.buttons.setStateChangeCallback(&button_handler);

  // Light the RGB LEDs
  tilda.setLED(1, 5, 20, 50);
  tilda.setLED(2, 5, 20, 50);
}

void loop()
{
  // See if there were any button changes
  tilda.buttons.poll();

  if(landscape)
    tilda.glcd.undoRotation();
  else
    tilda.glcd.setRot90();

  // Display some text on the GLCD
  tilda.glcd.firstPage();
  do
  {
    if(landscape)
      tilda.glcd.drawBitmapP(0, 0, 7, 64, cirno_bitmap);
    else
      tilda.glcd.drawBitmapP(0, 0, 7, 128, big_cirno_bitmap);
  }
  while(tilda.glcd.nextPage());

  delay(10);
}

/**
 * Basic handler for button state changes.
 */
void button_handler(buttonid_t id, uint8_t state)
{
  // Toggle backlight on pressing Light button
  if(state && (id == BUTTON_LIGHT))
    tilda.toggleBacklight();

  if(state && ((id == BUTTON_UP) || (id == BUTTON_DOWN)))
    landscape = false;

  if(state && ((id == BUTTON_LEFT) || (id == BUTTON_RIGHT)))
    landscape = true;
}
